## main/Kconfig.projbuild
```kconfig
menu "机器蜘蛛配置"

    config SPIDER_I2C_SDA_GPIO
        int "PCA9685 SDA GPIO"
        default 21
        range 0 39
        help
            PCA9685 的 SDA 引脚。与 hardware.md 接线一致时保持 21。

    config SPIDER_I2C_SCL_GPIO
        int "PCA9685 SCL GPIO"
        default 22
        range 0 39
        help
            PCA9685 的 SCL 引脚。与 hardware.md 接线一致时保持 22。

    config SPIDER_I2C_FREQ_HZ
        int "I2C 频率 (Hz)"
        default 400000
        range 50000 1000000
        help
            PCA9685 支持 1MHz；400kHz 为稳妥值。

    config SPIDER_PWM_FREQ_HZ
        int "舵机 PWM 频率 (Hz)"
        default 50
        range 40 100
        help
            舵机标准 PWM 50Hz（周期 20ms）。不建议改动。

    config SPIDER_MOTION_TICK_MS
        int "motion 任务周期 (ms)"
        default 2
        range 1 10
        help
            运动控制任务周期（M2 启用）。2ms 对应 500Hz 更新率，
            远高于 996R 的机械带宽，仅为保证插值平滑。

    config SPIDER_DEBUG_CLI
        bool "启用串口 CLI"
        default y
        help
            M1 起提供串口调试命令（与 Web 同命令集）。关闭可减小体积。

    config SPIDER_BENCH_MODE
        bool "单腿台架模式（通电不驱动舵机）"
        default n
        help
            台架模式：servo_tick() 不写任何 PWM，servo_set_mode() 进入标定
            模式时也不再把 8 路拉到中位。

            用途是单腿机械起止角标定。正常模式下 servo_tick() 是 PWM 的唯一
            写入口，关掉它即可保证「上电即静默」——因为 servo_init() 会把膝
            设成巡航 beta（出厂标定下约 1413µs），一旦启动就开始动，而那个位置
            与实际机械零位无关。

            台架下 PWM 完全由 CLI 的 leg 命令经 servo_pulse_raw() 驱动。

            整机调试时必须关闭，否则机器人完全不会动。

    config SPIDER_ESTOP_PIN
        int "物理急停按钮 GPIO"
        default -1
        range -1 39
        help
            外接硬件急停按钮的 GPIO。-1 表示不启用。
            软件急停（协议命令 + 心跳超时）始终有效，此项为额外保险。

    config SPIDER_PCA9685_OE_GPIO
        int "PCA9685 OE 引脚 GPIO"
        default 25
        range -1 39
        help
            PCA9685 的 OE（Output Enable，低有效）引脚所接的 ESP32 GPIO。
            OE 拉高即硬件级关断全部 16 路输出，不依赖固件是否在运行，
            因此 ESP32 复位、崩溃或卡在 bootloader 时舵机都会瘫软。

            硬件要求：该 GPIO 必须外接 10kΩ 上拉至 3.3V，使上电复位期间
            OE 默认为高（关断）。见 docs/hardware.md §5 接线表。

            -1 表示不接 OE（输出永久使能，无硬件急停能力）。

endmenu
```

## sdkconfig.defaults
```kconfig
#
# 机器蜘蛛默认配置（仅列需要偏离 ESP-IDF 默认值的项）
# 生成者：M0 骨架
# 硬件依据：docs/hardware.md
#

# --- 目标芯片 ---
CONFIG_IDF_TARGET="esp32"

# --- Flash 与分区 ---
# 4MB flash，单一 1.2MB app 分区；Web 控制页 gzip 后内嵌，留足余量
CONFIG_ESPTOOLPY_FLASHSIZE_4MB=y
CONFIG_PARTITION_TABLE_CUSTOM=y
CONFIG_PARTITION_TABLE_CUSTOM_FILENAME="partitions.csv"

# --- CPU 与 FreeRTOS ---
CONFIG_ESP_DEFAULT_CPU_FREQ_MHZ_240=y
# motion 任务 2ms tick 需要 1kHz 系统 tick
CONFIG_FREERTOS_HZ=1000
# 步态引擎用 tickless 会引入抖动，关闭
CONFIG_FREERTOS_USE_TICKLESS_IDLE=n

# --- 日志 ---
CONFIG_LOG_DEFAULT_LEVEL_INFO=y
CONFIG_LOG_MAXIMUM_LEVEL_DEBUG=y

# --- 看门狗 ---
CONFIG_ESP_TASK_WDT_TIMEOUT_S=10
# motion 任务周期短，禁止其加入 WDT 订阅
CONFIG_ESP_TASK_WDT_CHECK_IDLE_TASK_CPU0=n

# --- NVS ---
CONFIG_PARTITION_TABLE_FILENAME="partitions.csv"

# --- WiFi / Web（M3 启用）---
CONFIG_ESP_WIFI_ENABLED=y
# AP 模式：软 AP + httpd + WebSocket 控制通道
CONFIG_ESP_WIFI_SOFTAP_SUPPORT=y
CONFIG_LWIP_LOCAL_HOSTNAME="spider"

# --- HTTP Server / WebSocket ---
CONFIG_HTTPD_WS_SUPPORT=y

# --- lwIP 收缩（AP + 单页控制，无需大窗口/大缓冲）---
# Flash 已用 82%，这里主要回收 DRAM/IRAM
CONFIG_LWIP_TCP_SND_BUF_DEFAULT=11680
CONFIG_LWIP_TCP_WND_DEFAULT=11680
CONFIG_LWIP_TCPIP_RECVMBOX_SIZE=32
CONFIG_LWIP_UDP_RECVMBOX_SIZE=8
CONFIG_LWIP_TCPIP_TASK_STACK_SIZE=3072

# --- mbedTLS 收缩（我们只做明文 AP，不需要大握手缓冲与证书）---
CONFIG_MBEDTLS_SSL_IN_CONTENT_LEN=4096
CONFIG_MBEDTLS_SSL_OUT_CONTENT_LEN=4096
CONFIG_MBEDTLS_DYNAMIC_BUFFER=y

# --- 编译优化 ---
CONFIG_COMPILER_OPTIMIZATION_SIZE=y

# --- 栈检查 ---
# 运动任务栈 4096B，Web 任务栈 8192B，栈溢出对双足/四足是灾难性故障
CONFIG_COMPILER_STACK_CHECK=y
CONFIG_COMPILER_STACK_CHECK_MODE_STRONG=y
```
